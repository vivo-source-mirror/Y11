/* Copyright (c) 2019, The Linux Foundation. All rights reserved.
 *
 * This program is free software; you can redistribute it and/or modify
 * it under the terms of the GNU General Public License version 2 and
 * only version 2 as published by the Free Software Foundation.
 *
 * This program is distributed in the hope that it will be useful,
 * but WITHOUT ANY WARRANTY; without even the implied warranty of
 * MERCHANTABILITY or FITNESS FOR A PARTICULAR PURPOSE.  See the
 * GNU General Public License for more details.
 */

&mdss_mdp {
	dsi_pd2060_tm_ili9881h_hdplus_video: qcom,mdss_dsi_pd2060_tm_ili9881h_hdplus_video {
		qcom,mdss-dsi-panel-name = "dsi_pd2060_tm_ili9881h_hdplus_video panel";
		qcom,mdss-dsi-project-name = "pd2060";
		qcom,mdss-dsi-panel-type = "dsi_video_mode";

		qcom,dsi-ctrl-num = <0>;
		qcom,dsi-phy-num = <0>;

		qcom,mdss-dsi-virtual-channel-id = <0>;
		qcom,mdss-dsi-stream = <0>;
		qcom,mdss-dsi-bpp = <24>;
		qcom,mdss-dsi-underflow-color = <0x00>;
		qcom,mdss-dsi-border-color = <0>;
		qcom,mdss-dsi-reset-sequence =<1 10>, <0 5>, <1 12>;
		qcom,mdss-pan-physical-width-dimension = <68>;
		qcom,mdss-pan-physical-height-dimension = <151>;
		qcom,mdss-dsi-traffic-mode = "non_burst_sync_event";
		qcom,mdss-dsi-bllp-eof-power-mode;
		qcom,mdss-dsi-bllp-power-mode;
		qcom,mdss-dsi-lane-0-state;
		qcom,mdss-dsi-lane-1-state;
		qcom,mdss-dsi-lane-2-state;
		qcom,mdss-dsi-dma-trigger = "trigger_sw";
		qcom,mdss-dsi-mdp-trigger = "none";
		qcom,mdss-dsi-panel-id = <0x13>;
		qcom,mdss-dsi-lcmid-sequence = <0x13 0x45>;
		qcom,mdss-dsi-backlight-hw-id-offset = <7>;
		qcom,mdss-dsi-lp11-init;
		qcom,vivo-dsi-panel-type = "tft";
		qcom,mdss-dsi-panel-physical-type = "lcd";
		qcom,mdss-panel-sre;
		qcom,mdss-dsi-lcm-sre-max-level = <0x01>;
		qcom,bl-update-flag = "delay_until_first_frame";
		qcom,esd-check-more;

		qcom,mdss-dsi-on-cabc-levle1 = [
			39 01 00 00 00 00 04 FF 98 81 03
			39 01 00 00 00 00 02 AA DC
			39 01 00 00 00 00 04 FF 98 81 00
			39 01 00 00 00 00 02 53 2C
			39 01 00 00 00 00 02 55 02
			
		];

		qcom,mdss-dsi-on-cabc-levle2 = [
			39 01 00 00 00 00 04 FF 98 81 03
			39 01 00 00 00 00 02 AA BD
			39 01 00 00 00 00 04 FF 98 81 00
			39 01 00 00 00 00 02 53 2C
			39 01 00 00 00 00 02 55 03
			
		];

		qcom,mdss-dsi-on-cabc-levle3 = [
			39 01 00 00 00 00 02 53 2C
			39 01 00 00 00 00 02 55 03
		];

		qcom,mdss-dsi-on-cabc-off = [
			39 01 00 00 00 00 02 53 2C
			39 01 00 00 00 00 02 55 00
		];

		qcom,mdss-dsi-off-command = [
			05 01 00 00 11 00 01 28
			05 01 00 00 50 00 01 10
		];

		qcom,mdss-dsi-pre-off-command = [
			05 01 00 00 11 00 01 28
		];
		qcom,mdss-dsi-pre-on-command = [
			39 01 00 00 14 00 01 29
		];

		qcom,mdss-dsi-on-command-state = "dsi_lp_mode";
		qcom,mdss-dsi-off-command-state = "dsi_lp_mode";
		qcom,mdss-alpm-command-state = "dsi_hs_mode";

		qcom,mdss-dsi-display-timings {
			timing@0{
				qcom,mdss-dsi-panel-timings-phy-12nm = [11 08 10 04 00 07 04 0C];
				qcom,mdss-dsi-panel-timings-phy-12nm-russia = [12 09 10 05 01 07 05 0C];
				qcom,mdss-dsi-panel-width = <720>;
				qcom,mdss-dsi-panel-height = <1600>;
				qcom,mdss-dsi-h-front-porch = <44>;
				qcom,mdss-dsi-h-back-porch = <42>;
				qcom,mdss-dsi-h-pulse-width = <6>;
				qcom,mdss-dsi-h-sync-skew = <0>;
				qcom,mdss-dsi-h-sync-pulse = <0>;
				qcom,mdss-dsi-v-back-porch = <26>;
				qcom,mdss-dsi-v-front-porch = <250>;
				qcom,mdss-dsi-v-pulse-width = <4>;
				qcom,mdss-dsi-panel-framerate = <60>;
				qcom,mdss-dsi-h-left-border = <0>;
				qcom,mdss-dsi-h-right-border = <0>;
				qcom,mdss-dsi-v-top-border = <0>;
				qcom,mdss-dsi-v-bottom-border = <0>;
				qcom,mdss-dsi-on-command =
				[
					39 01 00 00 00 00 04 FF 98 81 06
					/*PWM OSC 64M */
					39 01 00 00 00 00 02 06 C4
					/*Sharpness SETTING Low Level */
					39 01 00 00 00 00 04 FF 98 81 04
					39 01 00 00 00 00 02 01 05
					/*CABC SETTING */
					39 01 00 00 00 00 04 FF 98 81 03
					39 01 00 00 00 00 02 81 35
					39 01 00 00 00 00 02 82 35
					39 01 00 00 00 00 02 8E 06
					39 01 00 00 00 00 02 94 0F
					39 01 00 00 00 00 02 95 10
					39 01 00 00 00 00 02 96 11
					39 01 00 00 00 00 02 97 11
					39 01 00 00 00 00 02 98 11
					39 01 00 00 00 00 02 99 12
					39 01 00 00 00 00 02 9A 13
					39 01 00 00 00 00 02 9B 14
					39 01 00 00 00 00 02 9C 15
					39 01 00 00 00 00 02 9D 15

					39 01 00 00 00 00 02 8F 05
					39 01 00 00 00 00 02 9E 06
					39 01 00 00 00 00 02 9F 06
					39 01 00 00 00 00 02 A0 08
					39 01 00 00 00 00 02 A1 0B
					39 01 00 00 00 00 02 A2 0D
					39 01 00 00 00 00 02 A3 0D
					39 01 00 00 00 00 02 A4 0E
					39 01 00 00 00 00 02 A5 0F
					39 01 00 00 00 00 02 A6 93
					39 01 00 00 00 00 02 A7 95


					39 01 00 00 00 00 02 A8 C0
					39 01 00 00 00 00 02 AE E6
					39 01 00 00 00 00 02 AF CB
					39 01 00 00 00 00 02 89 40
					/*SRE SETTING */
					39 01 00 00 00 00 04 FF 98 81 04
					39 01 00 00 00 00 02 03 09
					39 01 00 00 00 00 02 04 02
					39 01 00 00 00 00 02 05 92
					39 01 00 00 00 00 02 7C 2B
					39 01 00 00 00 00 04 FF 98 81 00
					/*Brightness Write */
					39 01 00 00 00 00 03 51 00 00
					/*PWM Enable */
					39 01 00 00 00 00 02 53 24
					/*backlight dimming */
					39 01 00 00 00 00 03 68 04 01
					/*CABC Control */
					39 01 00 00 00 00 02 55 00
					/*TE Enable*/
					39 01 00 00 00 00 02 35 00
					39 01 00 00 50 00 01 11
					/*PWM 12Bit 15.6KHz  */
					39 01 00 00 00 00 04 FF 98 81 03
					39 01 00 00 00 00 02 83 20
					39 01 00 00 00 00 02 84 00
					/*mura youhua  */
					39 01 00 00 00 00 04 FF 98 81 01
					39 01 00 00 00 00 02 0E 0A
					39 01 00 00 00 00 02 0F 0A
					39 01 00 00 00 00 02 12 0A
					39 01 00 00 00 00 02 B8 00
					39 01 00 00 00 00 04 FF 98 81 05
					39 01 00 00 00 00 02 6A 8D
					39 01 00 00 00 00 02 6B 7F
					39 01 00 00 00 00 04 FF 98 81 02
					39 01 00 00 00 00 02 01 35
					/*TS VGLO&VGL Setting  */
					39 01 00 00 00 00 04 FF 98 81 05
					39 01 00 00 00 00 02 CC 8D
					39 01 00 00 00 00 02 CD 8D
					39 01 00 00 00 00 02 CE 8D
					39 01 00 00 00 00 02 CF 8D
					39 01 00 00 00 00 02 D4 7F
					39 01 00 00 00 00 02 D5 7F
					39 01 00 00 00 00 02 D6 7F
					39 01 00 00 00 00 02 D7 7F
					/*OSC +1% */
					39 01 00 00 00 00 04 FF 98 81 06
					39 01 00 00 00 00 02 13 EB
					39 01 00 00 00 00 02 14 41
					39 01 00 00 00 00 02 15 98
					39 01 00 00 00 00 02 16 41
					
					/*Internal Porch Setting  */
					39 01 00 00 00 00 04 FF 98 81 06
					39 01 00 00 00 00 02 27 FF
					39 01 00 00 00 00 04 FF 98 81 02
					39 01 00 00 00 00 02 06 90
					/*gamma setting  */
					39 01 00 00 00 00 04 FF 98 81 0B
					39 01 00 00 00 00 02 80 01
					39 01 00 00 00 00 04 FF 98 81 0A

					39 01 00 00 00 00 04 FF 98 81 08

					39 01 00 00 00 00 04 FF 98 81 00
					39 01 00 00 0A 00 01 29
				];
/*
				qcom,mdss-dsi-on-cabc-levle1 = [
					39 01 00 00 00 00 02 53 2C
					39 01 00 00 00 00 02 55 02
					39 01 00 00 00 00 04 FF 98 81 03
					39 01 00 00 00 00 02 AA DC
					39 01 00 00 00 00 04 FF 98 81 00
				];

				qcom,mdss-dsi-on-cabc-levle2 = [
					39 01 00 00 00 00 02 53 2C
					39 01 00 00 00 00 02 55 03
					39 01 00 00 00 00 04 FF 98 81 03
					39 01 00 00 00 00 02 AA BD
					39 01 00 00 00 00 04 FF 98 81 00
				];

				qcom,mdss-dsi-on-cabc-levle3 = [
					39 01 00 00 00 00 02 53 2C
					39 01 00 00 00 00 02 55 03
				];

				qcom,mdss-dsi-on-cabc-off = [
					39 01 00 00 00 00 02 53 2C
					39 01 00 00 00 00 02 55 00
				];

				qcom,mdss-dsi-off-command = [
					05 01 00 00 11 00 01 28
					05 01 00 00 50 00 01 10
				];
//*/
			};
		};
	};
};

