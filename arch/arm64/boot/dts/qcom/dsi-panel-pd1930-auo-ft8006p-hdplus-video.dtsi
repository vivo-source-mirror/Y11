/* Copyright (c) 2018, The Linux Foundation. All rights reserved.
 *
 * This program is free software; you can redistribute it and/or modify
 * it under the terms of the GNU General Public License version 2 and
 * only version 2 as published by the Free Software Foundation.
 *
 * This program is distributed in the hope that it will be useful,
 * but WITHOUT ANY WARRANTY; without even the implied warranty of
 * MERCHANTABILITY or FITNESS FOR A PARTICULAR PURPOSE.  See the
 * GNU General Public License for more details.
 */

&mdss_mdp {
	dsi_pd1930_auo_ft8006p_hdplus_video: qcom,mdss_dsi_pd1930_auo_ft8006p_hdplus_video {
		qcom,mdss-dsi-panel-name = "mdss_dsi_pd1930_auo_ft8006p_hdplus_panel";
		qcom,mdss-dsi-panel-controller = <&mdss_dsi0>;
		qcom,mdss-dsi-panel-type = "dsi_video_mode";
		qcom,mdss-dsi-project-name = "pd1930";
		qcom,mdss-dsi-panel-destination = "display_1";
		qcom,mdss-dsi-panel-framerate = <60>;
		qcom,mdss-dsi-virtual-channel-id = <0>;
		qcom,mdss-dsi-stream = <0>;
		qcom,mdss-dsi-panel-id = <0x40>;
		qcom,mdss-dsi-panel-width = <720>;
		qcom,mdss-dsi-panel-height = <1544>;
		qcom,mdss-dsi-h-front-porch = <60>;
		qcom,mdss-dsi-h-front-porch-russia = <122>;
		qcom,mdss-dsi-h-back-porch = <46>;
		qcom,mdss-dsi-h-pulse-width = <14>;
		qcom,mdss-dsi-h-sync-skew = <0>;
		qcom,mdss-dsi-v-front-porch = <106>;
		qcom,mdss-dsi-v-back-porch = <130>;
		qcom,mdss-dsi-v-pulse-width = <8>;
		/delete-property/ qcom,mdss-dsi-panel-timings;
		qcom,mdss-dsi-panel-timings-phy-12nm = [10 08 10 05 00 07 05 0B];
		qcom,mdss-dsi-panel-timings-phy-12nm-russia = [13 09 10 05 01 07 05 0C];
		qcom,mdss-dsi-h-left-border = <0>;
		qcom,mdss-dsi-h-right-border = <0>;
		qcom,mdss-dsi-v-top-border = <0>;
		qcom,mdss-dsi-v-bottom-border = <0>;
		qcom,mdss-dsi-bpp = <24>;
		qcom,mdss-dsi-underflow-color = <0x00>;
		qcom,mdss-dsi-border-color = <0>;
		qcom,mdss-dsi-pixel-packing = "tight";
		qcom,mdss-panel-sre;
		qcom,platform-tp_reset-gpio = <&tlmm 64 0>;

		qcom,mdss-dsi-on-command = [
			39 01 00 00 00 00 02 41 5A
			39 01 00 00 00 00 03 41 5A 09
			39 01 00 00 00 00 06 80 64 00 64 00 00
			39 01 00 00 00 00 03 41 5A 0A
			39 01 00 00 00 00 11 80 A5 3E A5 AA A5 88 42 68 A6 03 07 01 61 3F 50 32
			39 01 00 00 00 00 11 90 0C 0F 22 00 2A 19 64 00 88 03 03 EE EE 00 3F 2A
			39 01 00 00 00 00 11 A0 00 30 02 32 11 0D 60 01 FF FF 03 40 42 0F 94 11
			39 01 00 00 00 00 11 B0 E8 03 00 00 11 0D 60 00 FF FF 03 FF 34 0C 0F 0E
			39 01 00 00 00 00 0B C0 1F 03 00 08 20 34 00 00 00 00
			39 01 00 00 00 00 03 41 5A 0B
			39 01 00 00 00 00 11 80 FF B4 B4 00 1A 16 2E 43 55 60 69 77 77 82 82 94
			39 01 00 00 00 00 11 90 72 62 64 5B 54 48 39 31 29 1B 12 08 0C 16 2E 43
			39 01 00 00 00 00 11 A0 47 52 69 77 77 82 82 94 72 62 64 5B 54 48 39 31
			39 01 00 00 00 00 06 B0 29 1B 12 08 00
			39 01 00 00 00 00 03 41 5A 0C
			39 01 00 00 00 00 11 80 00 00 20 42 00 00 80 05 54 00 00 00 20 42 00 00
			39 01 00 00 00 00 03 90 80 05
			39 01 00 00 00 00 03 41 5A 0D
			39 01 00 00 00 00 11 80 7A D0 02 08 06 1B 01 E6 00 0A 0A 0A 0A 00 01 03
			39 01 00 00 00 00 11 90 00 00 00 00 AC A2 2A 00 00 00 AC A2 2A 57 31 00
			39 01 00 00 00 00 11 A0 00 00 00 00 00 AC A2 2A AA C2 2A AC A2 2A AA C2
			39 01 00 00 00 00 07 B0 2A 00 00 00 AA 52
			39 01 00 00 00 00 03 41 5A 0E
			39 01 00 00 00 00 0D 80 F1 B1 71 EF 4B 20 37 0F AA AA 00 00
			39 01 00 00 00 00 03 41 5A 0F
			39 01 00 00 00 00 0C 80 FF 00 55 55 23 88 88 1C 00 5A 5A
			39 01 00 00 00 00 03 41 5A 10
			39 01 00 00 00 00 11 80 B5 45 09 18 01 3C 94 32 10 C4 C4 04 00 60 C0 00
			39 01 00 00 00 00 11 90 04 00 00 86 10 31 98 34 34 34 26 26 3E 1A 62 20
			39 01 00 00 00 00 05 A0 0C 40 00 8A
			39 01 00 00 00 00 03 41 5A 11
			39 01 00 00 00 00 11 80 00 00 02 E7 1F 17 08 48 68 12 90 1A 30 88 41 8A
			39 01 00 00 00 00 10 90 39 28 A9 C5 9A 7B F0 07 7E E0 07 7E 20 10 00
			39 01 00 00 00 00 03 41 5A 12
			39 01 00 00 00 00 11 80 00 00 00 00 00 01 00 00 00 00 00 01 00 00 41 37
			39 01 00 00 00 00 11 90 2D 23 19 0F 05 FB 05 FB 00 00 00 00 00 00 00 00
			39 01 00 00 00 00 11 A0 00 00 00 00 00 00 00 00 00 00 00 00 14 00 00 02
			39 01 00 00 00 00 11 B0 00 00 00 00 00 14 00 00 04 2D 23 0C 07 25 2D 23
			39 01 00 00 00 00 05 C0 0C 07 00 01
			39 01 00 00 00 00 03 41 5A 13
			39 01 00 00 00 00 11 80 FD 0F 00 0C 00 80 80 82 00 07 22 06 E7 B9 86 1A
			39 01 00 00 00 00 11 90 32 00 A2 2D 65 00 00 00 00 D0 C9 B7 FE 26 6F 32
			39 01 00 00 00 00 04 A0 22 90 04
			39 01 00 00 00 00 03 41 5A 14
			39 01 00 00 00 00 11 80 01 02 40 5E D1 DF EF F7 FB FD 02 00 00 04 8B 1B
			39 01 00 00 00 00 11 90 0F 5E C1 14 78 F0 07 E4 C0 83 1F 70 03 1E 68 00
			39 01 00 00 00 00 11 A0 1B F8 FD 22 58 C0 EF 37 00 30 02 00 00 00 00 00
			39 01 00 00 00 00 11 B0 00 00 00 00 00 00 20 00 00 48 61 14 56 00 80 42
			39 01 00 00 00 00 11 C0 A1 F0 67 F0 73 03 00 00 FE 0A 7E 6E 00 00 C0 1F
			39 01 00 00 00 00 11 D0 C1 CF 0D 00 00 F8 1B F8 B9 01 00 00 7F 02 3F 37
			39 01 00 00 00 00 11 E0 00 00 E0 2F E0 E7 06 00 00 FC 01 FC DC 00 00 80
			39 01 00 00 00 00 11 F0 5F 80 9F 1B 00 00 30 06 7E 3F 14 00 00 00 00 00
			39 01 00 00 00 00 03 41 5A 15
			39 01 00 00 00 00 11 80 00 00 00 00 00 00 00 00 00 00 00 00 0C 80 FF EF
			39 01 00 00 00 00 11 90 27 03 08 D6 8D F4 F7 03 00 00 1C 00 00 00 42 FC
			39 01 00 00 00 00 11 A0 7E 00 00 00 00 00 00 00 00 00 00 00 00 00 00 00
			39 01 00 00 00 00 11 B0 00 00 00 00 00 00 00 00 26 00 E0 01 28 A6 29 49
			39 01 00 00 00 00 11 C0 20 68 59 48 0B 28 02 43 38 06 04 99 A6 69 9A 51
			39 01 00 00 00 00 11 D0 64 59 20 F8 B4 47 53 2C 43 12 4C 93 69 9A A6 39
			39 01 00 00 00 00 11 E0 4D 20 68 59 49 1B 2C 43 53 3C 47 14 99 A6 69 9A
			39 01 00 00 00 00 11 F0 10 64 59 20 E8 B4 06 43 28 02 02 48 92 69 9A A4
			39 01 00 00 00 00 03 41 5A 16
			39 01 00 00 00 00 11 80 85 85 83 03 00 00 00 00 00 00 00 00 00 00 00 00
			39 01 00 00 00 00 0B 90 00 00 00 00 00 42 29 01 00 00
			39 01 00 00 00 00 03 41 5A 18
			39 01 00 00 00 00 11 80 EF BD F7 DE 7B EF BD 07 08 08 0A 0C 0C 0C 0C 0C
			39 01 00 00 00 00 11 90 0C 0C 0C 5C 09 A8 AA AA AA AA AA AA AA AA AA 5A
			39 01 00 00 00 00 11 A0 59 59 59 59 59 59 59 59 59 59 59 09 04 FF 00 80
			39 01 00 00 00 00 10 B0 80 00 04 20 00 01 08 40 00 02 10 80 00 04 00
			39 01 00 00 00 00 03 41 5A 19
			39 01 00 00 00 00 11 80 E0 CA BB B2 A9 9E 98 92 8E 89 85 82 77 F7 FF FF
			39 01 00 00 00 00 11 90 FF FF FF BF 7F 3F 0F FF 6F 52 8D 4A E8 E7 07 08
			39 01 00 00 00 00 05 A0 00 00 46 00
			39 01 00 00 00 00 03 41 5A 1A
			39 01 00 00 00 00 11 80 FF 00 04 08 0C 50 10 14 18 1C A9 20 28 31 38 DB
			39 01 00 00 00 00 11 90 40 49 51 59 02 61 69 71 79 00 81 89 91 99 00 A1
			39 01 00 00 00 00 11 A0 A9 B1 B9 00 C1 C9 D0 D8 F0 E0 E8 F0 F8 0F FC FE
			39 01 00 00 00 00 11 B0 FF 00 00 03 07 0B AC 0F 13 16 1A 71 1E 25 2D 35
			39 01 00 00 00 00 11 C0 7D 3C 44 4C 53 86 5B 62 6A 72 2D 79 81 89 90 87
			39 01 00 00 00 00 11 D0 98 9F A7 AF 1C B6 BE C5 CD 72 D4 DC E4 EB 9B EF
			39 01 00 00 00 00 11 E0 F1 F2 15 00 03 07 0A D8 0E 12 15 19 72 1D 24 2C
			39 01 00 00 00 00 11 F0 33 88 3B 42 49 51 78 58 60 67 6F 27 76 7E 85 8D
			39 01 00 00 00 00 03 41 5A 1B
			39 01 00 00 00 00 11 80 62 94 9C A4 AB CB B3 BB C3 CB 16 D3 DB E3 EB 74
			39 01 00 00 00 00 06 90 EF F1 F2 00 00
			39 01 00 00 00 00 03 41 5A 1C
			39 01 00 00 00 00 11 80 33 22 00 03 5A 02 5A 54 E5 FF C7 20 18 28 18 08
			39 01 00 00 00 00 11 90 10 0C 07 09 06 06 0A 10 0C 09 0B 06 26 F2 78 40
			39 01 00 00 00 00 11 A0 20 08 08 06 13 C0 34 1E 0A 08 66 D1 A0 1C 20 20
			39 01 00 00 00 00 11 B0 18 04 20 00 C0 04 28 01 4C 00 23 18 10 0A 06 C9
			39 01 00 00 00 00 11 C0 04 70 41 58 54 B5 4A 55 15 00 78 F8 99 99 99 99
			39 01 00 00 00 00 11 D0 99 99 88 88 88 88 88 88 08 C4 E3 81 00 20 80 27
			39 01 00 00 00 00 11 E0 E2 89 00 00 00 00 40 00 80 30 04 41 06 00 00 00
			39 01 00 00 00 00 11 F0 00 92 24 49 92 04 00 00 00 00 92 04 00 C0 03 40
			39 01 00 00 00 00 03 41 5A 1D
			39 01 00 00 00 00 11 80 00 01 54 0B 23 18 00 00 80 00 00 00 00 00 00 00
			39 01 00 00 00 00 03 41 5A 22
			39 01 00 00 00 00 10 80 00 5E 00 00 00 00 00 00 5E 00 00 00 00 00 00
			39 01 00 00 00 00 03 41 5A 24
			39 01 00 00 00 00 11 80 2D D3 00 55 55 55 55 55 55 55 55 1F 00 AA 3E 00
			39 01 00 00 00 00 05 90 00 00 00 00
			39 01 00 00 00 00 03 41 5A 25
			39 01 00 00 00 00 11 80 01 05 00 05 00 00 00 00 00 00 00 00 00 00 01 00
			39 01 00 00 00 00 0C 90 00 00 00 24 00 00 00 00 FF 07 35
			39 01 00 00 00 00 03 41 5A 26
			39 01 00 00 00 00 11 80 00 83 00 FF FF 60 00 01 00 00 00 00 00 00 CE 12
			39 01 00 00 00 00 04 90 5A A5 5A
			39 01 00 00 00 00 02 90 A5
			39 01 00 00 00 00 03 41 00 2F
			39 01 00 00 00 00 02 4C 03

			29 01 00 00 55 00 02 11 00
			39 01 00 00 00 00 03 51 00 00
			39 01 00 00 00 00 02 53 24
			39 01 00 00 00 00 02 55 01
			29 01 00 00 05 00 02 29 00
		];

		qcom,mdss-dsi-off-command = [
			29 01 00 00 00 00 01 28
			29 01 00 00 A0 00 01 10
			29 01 00 00 00 00 03 41 5A 0E
			29 01 00 00 00 00 02 80 71
			29 01 00 00 00 00 03 41 00 2F

		];

		qcom,mdss-dsi-on-cabc-levle1 = [
			29 01 00 00 00 00 02 53 2C
			29 01 00 00 00 00 02 55 01
 		];

 		qcom,mdss-dsi-on-cabc-levle2 = [
 			29 01 00 00 00 00 02 53 2C
			29 01 00 00 00 00 02 55 02
 		];

 		qcom,mdss-dsi-on-cabc-levle3 = [
 			29 01 00 00 00 00 02 53 2C
			29 01 00 00 00 00 02 55 03
 		];
 		qcom,mdss-dsi-on-cabc-off = [
 			29 01 00 00 00 00 02 53 2C
			29 01 00 00 00 00 02 55 00
 		];

		qcom,mdss-dsi-on-backlight-diming = [
			39 01 00 00 00 00 02 53 2C
	        ];

		qcom,mdss-dsi-dimming-off-command = [
			29 01 00 00 00 00 02 53 24
	        ];

		qcom,mdss-dsi-on-command-state = "dsi_lp_mode";
		qcom,mdss-dsi-off-command-state = "dsi_lp_mode";
		qcom,mdss-dsi-h-sync-pulse = <1>;
		qcom,mdss-dsi-traffic-mode = "non_burst_sync_event";
		qcom,mdss-dsi-bllp-eof-power-mode;
		qcom,mdss-dsi-bllp-power-mode;
		qcom,mdss-dsi-tx-eot-append;
		qcom,mdss-dsi-lane-0-state;
		qcom,mdss-dsi-lane-1-state;
		qcom,mdss-dsi-lane-2-state;
		qcom,mdss-dsi-init-delay-us = <15000>;

		qcom,mdss-dsi-t-clk-post = <0x0C>;
		qcom,mdss-dsi-t-clk-pre = <0x28>;

		qcom,mdss-dsi-bl-pmic-control-type = "bl_ctrl_dcs";
		qcom,mdss-dsi-bl-min-level = <1>;
		qcom,mdss-dsi-bl-max-level = <4095>;
		qcom,mdss-brightness-max-level = <4095>;

		qcom,mdss-dsi-dma-trigger = "trigger_sw";
		qcom,mdss-dsi-mdp-trigger = "none";
		qcom,panel-supply-entries = <&dsi_panel_pwr_supply>;
		qcom,mdss-dsi-reset-sequence = <1 1>, <0 0>, <1 11>;
		/*qcom,suspend-ulps-enabled;*/
		qcom,mdss-dsi-lp11-init;
		qcom,mdss-pan-physical-width-dimension = <69>;
		qcom,mdss-pan-physical-height-dimension = <146>;
		qcom,mdss-dsi-lcm-sre-max-level = <0x40>;

		//ESD  read register check
		qcom,esd-check-enabled;
		qcom,mdss-dsi-panel-status-command = [06 01 00 01 05 00 02 0A 08];
		qcom,mdss-dsi-panel-status-command-state = "dsi_lp_mode";
		qcom,mdss-dsi-panel-status-check-mode = "reg_read";
		qcom,mdss-dsi-panel-status-value = <0x9c>;
		qcom,mdss-dsi-panel-status-read-length = <1>;
		qcom,mdss-dsi-panel-max-error-count = <5>;
		qcom,mdss-tp-esd-delay-ms = <500>;
	};
};
