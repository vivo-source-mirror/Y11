/* Copyright (c) 2019, The Linux Foundation. All rights reserved.
 *
 * This program is free software; you can redistribute it and/or modify
 * it under the terms of the GNU General Public License version 2 and
 * only version 2 as published by the Free Software Foundation.
 *
 * This program is distributed in the hope that it will be useful,
 * but WITHOUT ANY WARRANTY; without even the implied warranty of
 * MERCHANTABILITY or FITNESS FOR A PARTICULAR PURPOSE.  See the
 * GNU General Public License for more details.
 */

&mdss_mdp {
	dsi_pd2060_tm_ili9882n_hdplus_video: qcom,mdss_dsi_pd2060_tm_ili9882n_hdplus_video {
		qcom,mdss-dsi-panel-name = "dsi_pd2060_tm_ili9882n_hdplus_video panel";
		qcom,mdss-dsi-project-name = "pd2060";
		qcom,mdss-dsi-panel-type = "dsi_video_mode";

		qcom,dsi-ctrl-num = <0>;
		qcom,dsi-phy-num = <0>;

		qcom,mdss-dsi-virtual-channel-id = <0>;
		qcom,mdss-dsi-stream = <0>;
		qcom,mdss-dsi-bpp = <24>;
		qcom,mdss-dsi-underflow-color = <0x00>;
		qcom,mdss-dsi-border-color = <0>;
		qcom,mdss-dsi-reset-sequence =<1 10>, <0 5>, <1 12>;
		qcom,mdss-pan-physical-width-dimension = <68>;
		qcom,mdss-pan-physical-height-dimension = <151>;
		qcom,mdss-dsi-traffic-mode = "non_burst_sync_event";
		qcom,mdss-dsi-bllp-eof-power-mode;
		qcom,mdss-dsi-bllp-power-mode;
		qcom,mdss-dsi-lane-0-state;
		qcom,mdss-dsi-lane-1-state;
		qcom,mdss-dsi-lane-2-state;
		qcom,mdss-dsi-dma-trigger = "trigger_sw";
		qcom,mdss-dsi-mdp-trigger = "none";
		qcom,mdss-dsi-panel-id = <0x12>;
		qcom,mdss-dsi-lcmid-sequence = <0x12 0x4F>;
		qcom,mdss-dsi-backlight-hw-id-offset = <7>;
		qcom,mdss-dsi-lp11-init;
		qcom,vivo-dsi-panel-type = "tft";
		qcom,mdss-dsi-panel-physical-type = "lcd";
		qcom,mdss-panel-sre;
		qcom,mdss-dsi-lcm-sre-max-level = <0x01>;
		qcom,bl-update-flag = "delay_until_first_frame";
		qcom,esd-check-more;

		qcom,mdss-dsi-on-cabc-levle1 = [
			39 01 00 00 00 00 04 FF 98 82 03
			39 01 00 00 00 00 02 BA 00
			39 01 00 00 00 00 04 FF 98 82 00
			39 01 00 00 00 00 02 53 2C
			39 01 00 00 00 00 02 55 02
		];

		qcom,mdss-dsi-on-cabc-levle2 = [
			39 01 00 00 00 00 04 FF 98 82 03
			39 01 00 00 00 00 02 BA 00
			39 01 00 00 00 00 04 FF 98 82 00
			39 01 00 00 00 00 02 53 2C
			39 01 00 00 00 00 02 55 03
		];

		qcom,mdss-dsi-on-cabc-levle3 = [
			39 01 00 00 00 00 04 FF 98 82 03
			39 01 00 00 00 00 02 BA 00
			39 01 00 00 00 00 04 FF 98 82 00
			39 01 00 00 00 00 02 53 2C
			39 01 00 00 00 00 02 55 03
		];

		qcom,mdss-dsi-on-cabc-off = [
			39 01 00 00 00 00 02 53 2C
			39 01 00 00 00 00 02 55 00
		];

		qcom,mdss-dsi-off-command = [
			05 01 00 00 11 00 01 28
			05 01 00 00 50 00 01 10
		];

		qcom,mdss-dsi-pre-off-command = [
			05 01 00 00 11 00 01 28
		];
		qcom,mdss-dsi-pre-on-command = [
			39 01 00 00 14 00 01 29
		];

		qcom,mdss-dsi-on-command-state = "dsi_lp_mode";
		qcom,mdss-dsi-off-command-state = "dsi_lp_mode";
		qcom,mdss-alpm-command-state = "dsi_hs_mode";

		qcom,mdss-dsi-display-timings {
			timing@0{
				qcom,mdss-dsi-panel-width = <720>;
				qcom,mdss-dsi-panel-height = <1600>;
				qcom,mdss-dsi-h-front-porch = <44>;
				qcom,mdss-dsi-h-back-porch = <42>;
				qcom,mdss-dsi-h-pulse-width = <6>;
				qcom,mdss-dsi-h-sync-skew = <0>;
				qcom,mdss-dsi-h-sync-pulse = <0>;
				qcom,mdss-dsi-v-back-porch = <26>;
				qcom,mdss-dsi-v-front-porch = <250>;
				qcom,mdss-dsi-v-pulse-width = <4>;
				qcom,mdss-dsi-panel-framerate = <60>;
				qcom,mdss-dsi-h-left-border = <0>;
				qcom,mdss-dsi-h-right-border = <0>;
				qcom,mdss-dsi-v-top-border = <0>;
				qcom,mdss-dsi-v-bottom-border = <0>;
				qcom,mdss-dsi-on-command =
				[
					//PWM 12BIT 15K
					39 01 00 00 00 00 04 FF  98 82 06   
					39 01 00 00 00 00 02 06  A4 
					39 01 00 00 00 00 04 FF  98 82 03
					39 01 00 00 00 00 02 83  20
					39 01 00 00 00 00 02 84  00
					//CABC             
					39 01 00 00 00 00 04 FF 98 82 03
					39 01 00 00 00 00 02 81 35    //dimming
					39 01 00 00 00 00 02 82 35
					39 01 00 00 00 00 02 8C BB
					39 01 00 00 00 00 02 8D C2
					39 01 00 00 00 00 02 8E CA
					39 01 00 00 00 00 02 8F CB
					39 01 00 00 00 00 02 90 CC
					39 01 00 00 00 00 02 91 D2
					39 01 00 00 00 00 02 92 DA
					39 01 00 00 00 00 02 93 E3
					39 01 00 00 00 00 02 94 EB
					39 01 00 00 00 00 02 95 EC
					39 01 00 00 00 00 02 96 7D
					39 01 00 00 00 00 02 97 7E
					39 01 00 00 00 00 02 98 89
					39 01 00 00 00 00 02 99 9D
					39 01 00 00 00 00 02 9A AB
					39 01 00 00 00 00 02 9B AF
					39 01 00 00 00 00 02 9C B3
					39 01 00 00 00 00 02 9D BA
					39 01 00 00 00 00 02 9E D9
					39 01 00 00 00 00 02 9F EA
					39 01 00 00 00 00 02 AF 18
					39 01 00 00 00 00 02 A0 C0
					39 01 00 00 00 00 02 A7 F6
					39 01 00 00 00 00 02 A8 E8

					//SRE
					39 01 00 00 00 00 04 FF 98 82 04
					39 01 00 00 00 00 02 03 09
					39 01 00 00 00 00 02 04 02
					39 01 00 00 00 00 02 05 82
					39 01 00 00 00 00 02 78 05
					//SHARPNESS
					39 01 00 00 00 00 04 FF 98 82 04
					39 01 00 00 00 00 02 01 21
					39 01 00 00 00 00 04 FF 98 82 00 //Page0
					39 01 00 00 00 00 03 68 04 01  //pwm dimmy
					39 01 00 00 00 00 03 51 00 00
					39 01 00 00 00 00 02 53 2C
					39 01 00 00 00 00 02 55 00
					39 01 00 00 00 00 02 35 00
					39 01 00 00 50 00 01 11
					39 01 00 00 00 00 04 FF 98 82 0B   //OSC 30.24
					39 01 00 00 00 00 02 9B 30
					39 01 00 00 00 00 02 9E 69
					39 01 00 00 00 00 02 9F 69
					39 01 00 00 00 00 04 FF 98 82 01
					39 01 00 00 00 00 02 12 00
					39 01 00 00 00 00 04 FF 98 82 05  //VGL
					39 01 00 00 00 00 02 58 63
					39 01 00 00 00 00 04 FF 98 82 06
					39 01 00 00 00 00 02 08 21
					39 01 00 00 00 00 04 FF 98 82 00 //Page0
					39 01 00 00 0A 00 01 29
				];


				qcom,mdss-dsi-panel-timings-phy-12nm = [11 08 10 04 00 07 04 0C];
				qcom,mdss-dsi-panel-timings-phy-12nm-russia = [12 09 10 05 01 07 05 0C];

			};
		};
	};
};

